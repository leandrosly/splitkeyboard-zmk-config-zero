## config/boards/shields/zero/Kconfig.defconfig
```kconfig
if SHIELD_ZERO

config ZMK_KEYBOARD_NAME
    default "Zero"

endif

if SHIELD_ONE

config ZMK_KEYBOARD_NAME
    default "One"

endif
```

## config/boards/shields/zero/Kconfig.shield
```kconfig
config SHIELD_ZERO
    def_bool $(shields_list_contains, Zero)

config SHIELD_ONE
    def_bool $(shields_list_contains, One)
```
