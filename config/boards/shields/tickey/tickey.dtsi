/ {

    encoder: encoder {
        compatible = "alps,ec11";
        label = "ENCODER";
        a-gpios = <&gpio0 9 (GPIO_ACTIVE_HIGH | GPIO_PULL_UP)>;
        b-gpios = <&gpio0 10 (GPIO_ACTIVE_HIGH | GPIO_PULL_UP)>;
        /* IMU = gpio0 16, gpio1 0 and gpio1 10 */
        /* NFC = gpio0 9 and gpio0 10 */
        steps = <48>;
		status = "disabled";
	};

	sensors {
		compatible = "zmk,keymap-sensors";
		sensors = <&encoder>;
        triggers-per-rotation = <24>;
	};

};
