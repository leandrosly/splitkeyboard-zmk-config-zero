#include <behaviors.dtsi>
#include <dt-bindings/zmk/keys.h>

/ {

    keymap {
        compatible = "zmk,keymap";

        default_layer {
            bindings = <&kp M>;
            sensor-bindings = <&inc_dec_kp C_VOL_DN C_VOL_UP>;
        };
    };

};