/ {
	pro_micro: connector {
		compatible = "sparkfun,pro-micro";
		#gpio-cells = <2>;
		gpio-map-mask = <0xffffffff 0xffffffc0>;
		gpio-map-pass-thru = <0 0x3f>;
		gpio-map =
			<0 0 &gpio0 0 0>,
			<1 0 &gpio0 1 0>,
			<2 0 &gpio0 2 0>,
			<3 0 &gpio0 3 0>,
			<4 0 &gpio0 4 0>,
			<5 0 &gpio0 5 0>,
			<6 0 &gpio0 6 0>,
			<7 0 &gpio0 7 0>,
			<8 0 &gpio0 8 0>,
			<9 0 &gpio0 9 0>,
			<10 0 &gpio0 10 0>,
			<11 0 &gpio0 11 0>,
			<12 0 &gpio0 12 0>,
			<13 0 &gpio0 13 0>,
			<14 0 &gpio0 14 0>,
			<15 0 &gpio0 15 0>,
			<17 0 &gpio0 17 0>,
			<18 0 &gpio0 18 0>,
			<19 0 &gpio0 19 0>,
			<20 0 &gpio0 20 0>,
			<21 0 &gpio0 21 0>,
			<22 0 &gpio0 22 0>,
			<23 0 &gpio0 23 0>,
			<24 0 &gpio0 24 0>,
			<25 0 &gpio0 25 0>,
			<26 0 &gpio0 26 0>,
			<27 0 &gpio0 27 0>,
			<28 0 &gpio0 28 0>,
			<29 0 &gpio0 29 0>;
	};
};