#include <behaviors.dtsi>
#include <dt-bindings/zmk/keys.h>

/ {
    keymap {
        compatible = "zmk,keymap";

        default_layer {
            bindings =
                <&kp M>,
                <&kp X>,
                <&kp S>,
                <&kp A>,
                <&kp B>,
                <&kp V>,
                <&kp G>,
                <&kp P>,
                <&kp Q>;

            sensor-bindings = 
                <&inc_dec_kp C_VOL_UP C_VOL_DN>,
                <&inc_dec_kp C_VOL_UP C_VOL_DN>;
        };
    };
};